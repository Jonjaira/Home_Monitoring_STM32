## motion-sensor/main/Kconfig.projbuild
```kconfig
menu "Motion Sensor Configuration"

config MOTION_IPV4_ADDR
    string "IPV4 Address"
    default "192.168.1.76"
    help
       The sensor will connect to this IPV4 address.

config MOTION_SENSOR_PORT
    int "Port"
    range 0 65535
    default 3333
    help
        The remote port to which the client sensor will connect to.

config MOTION_WIFI_SSID
    string "WiFi SSID"
    default "myssid"
    help
        SSID (network name) for the sensor to connect to.

config MOTION_WIFI_PASSWORD
    string "WiFi Password"
    default "mypassword"
    help
        WiFi password (WPA or WPA2) for the senso to use.
endmenu
```

## temp-sensor/main/Kconfig.projbuild
```kconfig
menu "Temperature Sensor Configuration"

config TS_IPV4_ADDR
    string "IPV4 Address"
    default "192.168.1.76"
    help
       The sensor will connect to this IPV4 address.

config TS_SENSOR_PORT
    int "Port"
    range 0 65535
    default 3333
    help
        The remote port to which the client sensor will connect to.

config TS_WIFI_SSID
    string "WiFi SSID"
    default "myssid"
    help
        SSID (network name) for the sensor to connect to.

config TS_WIFI_PASSWORD
    string "WiFi Password"
    default "mypassword"
    help
        WiFi password (WPA or WPA2) for the senso to use.
endmenu
```

## wifi-access-point/main/Kconfig.projbuild
```kconfig
menu "WiFi Access Point Configuration"

    config ESP_WIFI_AP_SSID
        string "WiFi SSID"
        default "myssid"
        help
            Access Point WiFi SSID.

    config ESP_WIFI_AP_PASSWORD
        string "WiFi Password"
        default "mypassword"
        help
            Access Point WiFi password (WPA or WPA2).

    config ESP_MAX_STA_CONN
        int "Maximal STA connections"
        default 4
        help
            Max number of the STA connects to AP.

    config ESP_WIFI_AP_PORT
        int "Port"
        range 0 65535
        default 3333
        help
            Local port the TCPIP server socket will listen on.
        
endmenu
```
